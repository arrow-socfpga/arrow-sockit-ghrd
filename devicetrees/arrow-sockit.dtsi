/ {
	fragment@0 {
	        __overlay__ {
	                fpga-bridges = <&fpga_bridge0 &fpga_bridge1 &fpga_bridge2 &fpga_bridge3>;
	                
			clk_0: clk_0 {
				compatible = "fixed-clock";
				#clock-cells;
				clock-frequency;
				clock-output-names = "clk_0-clk";
			};

			pll_stream: pll_stream {
				compatible = "fixed-clock";
				#clock-cells;
				clock-frequency;
				clock-output-names = "pll_stream-clk";
			};
			
                        leds: leds {
				compatible = "gpio-leds";

				led_fpga0: fpga0 {
					label = "fpga_led0";
					gpios = <&led_pio 0 1>;
				};

				led_fpga1: fpga1 {
					label = "fpga_led1";
					gpios = <&led_pio 1 1>;
				};

				led_fpga2: fpga2 {
					label = "fpga_led2";
					gpios = <&led_pio 2 1>;
				};

				led_fpga3: fpga3 {
					label = "fpga_led3";
					gpios = <&led_pio 3 1>;
				};
			};
		};
	};

	// Altera VIP Suite Frame Reader
	fragment@1 {
		target-path = "/soc/base-fpga-region";
		__overlay__ {
			alt_vip_vfr_vga: vip@0x100010100 {
				compatible = "altr,vip-frame-reader-1.0";
				reg = <0x00000001 0x00010100 0x00000080>;
				max-width = <1920>;
				max-height = <1080>;
				bits-per-color = <8>;
				mem-word-width = <128>;
			};
		};
	};
};
